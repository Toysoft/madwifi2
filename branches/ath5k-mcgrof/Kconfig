## branches/ath5k-mcgrof/Kconfig
```kconfig
comment "Atheros 802.11(a/b/g) PCI/Cardbus support"

config ATHEROS
	tristate "Atheros PCI/Cardbus cards"
	depends on PCI && NET_RADIO
       ---help---
	  Say Y here if you intend to attach an Atheros Cardbus or PCI
	  wireless Ethernet networking card to your computer.  This
	  driver support the standard Linux Wireless Extensions.

	  To compile this driver as a module, choose M here: the module will be
	  called ath5k_pci.  If unsure, say N.
```

## branches/ath5k/Kconfig
```kconfig
comment "Atheros 5xxx series 802.11(a/b/g) PCI/Cardbus support"

config ATH5K
	tristate "Atheros 5xxx PCI/Cardbus cards"
	depends on PCI && MAC80211 && WLAN_80211 && EXPERIMENTAL
	---help---
	  Say Y here if you intend to attach an Atheros 5xxx 
	  series Cardbus or PCI wireless Ethernet networking card to 
	  your computer. This driver uses mac80211 stack.

	  To compile this driver as a module, choose M here: the module will be
	  called ath5k.  If unsure, say M.

config ATH5K_AR5210
	bool "Support AR5210"
	depends on ATH5K
	default y

config ATH5K_AR5211
	bool "Support AR5211"
	depends on ATH5K
	default y

config ATH5K_AR5212
	bool "Support AR5212"
	depends on ATH5K
	default y
```
